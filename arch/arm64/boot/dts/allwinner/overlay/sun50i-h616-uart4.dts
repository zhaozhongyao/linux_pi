/dts-v1/;
/plugin/;

/ {
	compatible = "allwinner,sun50i-h616";

	fragment@0 {
		target-path = "/aliases";
		__overlay__ {
			serial4 = "/soc/serial@5001000";
		};
	};

	fragment@1 {
		target = <&uart4>;
		 __overlay__ {
			pinctrl-names = "default";
			pinctrl-0 = <&uart4_ph_pins>;
			status = "okay";
		};
	};
};
